## main/KConfig.projbuild
```kconfig
menu "Example Configuration"

    config ESP_WIFI_SSID
        string "SoftAP SSID"
        default "ESP32_AP"
        help
            SSID (network name) that ESP32 will broadcast in SoftAP mode.

    config ESP_WIFI_PASSWORD
        string "SoftAP Password"
        default "12345678"
        help
            SoftAP password (must be at least 8 chars).

    config ESP_MAXIMUM_RETRY
        int "Maximum retry (not used in SoftAP)"
        default 5
        help
            For STA mode – unused here.

endmenu
```

## managed_components/vgerwen__hcsr04/Kconfig
```kconfig
menu "HC SR04 menu"

        config TRIGGER_PIN
            int "GPIO pin number HC SR 04 Trigger pulse"
            default 33
            help
                This option sets the ESP32 GPIO pin for HC SR04 trigger pin
        config ECHO_PIN
            int "GPIO pin number HC SR04 echo signal"
            default 32
            help
                This option sets the ESP32 GPIO pin for the HC SR04 echo pin
    endmenu
```
